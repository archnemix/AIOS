## os/buildroot/Config.in
```kconfig
source "$BR2_EXTERNAL_AIOS_PATH/package/llama-cpp/Config.in"
source "$BR2_EXTERNAL_AIOS_PATH/package/aios-keygen/Config.in"
source "$BR2_EXTERNAL_AIOS_PATH/package/aios-hardware/Config.in"
```

## os/buildroot/configs/aios_x86_64_defconfig
```kconfig
BR2_x86_64=y
BR2_PACKAGE_HOST_LINUX_HEADERS_CUSTOM_6_12=y
BR2_TOOLCHAIN_BUILDROOT_CXX=y
BR2_SYSTEM_DHCP="eth0"
# BR2_TARGET_ENABLE_ROOT_LOGIN is not set
# BR2_TARGET_GENERIC_GETTY is not set
BR2_ROOTFS_OVERLAY="$(BR2_EXTERNAL_AIOS_PATH)/board/aios/rootfs-overlay"
BR2_ROOTFS_USERS_TABLES="$(BR2_EXTERNAL_AIOS_PATH)/board/aios/users.txt"
BR2_LINUX_KERNEL=y
BR2_LINUX_KERNEL_CUSTOM_VERSION=y
BR2_LINUX_KERNEL_CUSTOM_VERSION_VALUE="6.12.27"
BR2_LINUX_KERNEL_USE_CUSTOM_CONFIG=y
BR2_LINUX_KERNEL_CUSTOM_CONFIG_FILE="board/qemu/x86_64/linux.config"
BR2_LINUX_KERNEL_NEEDS_HOST_LIBELF=y
BR2_TARGET_ROOTFS_EXT2=y
BR2_TARGET_ROOTFS_EXT2_SIZE="256M"
# BR2_TARGET_ROOTFS_TAR is not set
BR2_PACKAGE_LLAMA_CPP=y
BR2_PACKAGE_AIOS_HARDWARE=y
BR2_PACKAGE_BUSYBOX_CONFIG_FRAGMENT_FILES="$(BR2_EXTERNAL_AIOS_PATH)/board/aios/busybox.fragment"
```

## os/buildroot/package/aios-hardware/Config.in
```kconfig
config BR2_PACKAGE_AIOS_HARDWARE
	bool "AIOS CPU and memory probe"
	help
	  Reports CPU topology and recommends a conservative thread count.
```

## os/buildroot/package/aios-keygen/Config.in
```kconfig
config BR2_PACKAGE_AIOS_KEYGEN
	bool "AIOS boot key generator"
	help
	  Generates an ephemeral API key using the kernel random number generator.
```

## os/buildroot/package/llama-cpp/Config.in
```kconfig
config BR2_PACKAGE_LLAMA_CPP
	bool "AIOS llama.cpp server"
	depends on BR2_x86_64
	depends on BR2_INSTALL_LIBSTDCPP
	depends on BR2_TOOLCHAIN_HAS_THREADS
	help
	  CPU-only OpenAI-compatible inference server from llama.cpp.
```
